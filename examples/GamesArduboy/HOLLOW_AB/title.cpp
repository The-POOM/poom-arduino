#include "common.h"

/*  Defines  */

#define STATE_MENU      0
#define STATE_RECORD    1
#define STATE_CREDIT    2

#define RECORD_NOT_READ 0
#define RECORD_INITIAL  1
#define RECORD_STORED   2

constexpr uint32_t RecordSignature = 0x014E424FUL; // "OBN\x01"
constexpr const char *RecordKey = "records";

struct HollowRecord {
    uint32_t signature;
    uint16_t highScores[10];
    uint16_t playCount;
    uint16_t reserved;
    uint32_t playFrames;
};

static_assert(sizeof(HollowRecord) == 32, "Unexpected HOLLOW record layout");

/*  Local Functions  */

static void readRecord(void);
static void setSound(bool enabled);
static void playSound1(void);
static void playSound2(void);

/*  Local Variables  */

PROGMEM static const uint8_t imgTitle1[] = { // "Hollow" 84x20
    0xFE, 0xFE, 0xFE, 0xFE, 0xFE, 0x80, 0x80, 0x80, 0x80, 0x80, 0x80, 0x80, 0xFE, 0xFE, 0xFE, 0xFE,
    0xFE, 0x00, 0x00, 0x00, 0x00, 0x80, 0x80, 0xC0, 0xC0, 0xC0, 0xC0, 0xC0, 0xC0, 0x80, 0x80, 0x00,
    0x00, 0x00, 0xFF, 0xFF, 0xFF, 0xFF, 0xFF, 0x00, 0x00, 0xFF, 0xFF, 0xFF, 0xFF, 0xFF, 0x00, 0x00,
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    0x00, 0x00, 0x07, 0x07, 0x07, 0x07, 0x07, 0x07, 0x03, 0x00, 0x00, 0x00,
};

PROGMEM static const uint8_t imgTitle2[] = { // "Seeker" 80x20
    0xF0, 0xF8, 0xFC, 0xFE, 0xFE, 0x9E, 0x1E, 0x1E, 0x1E, 0x1E, 0x3C, 0x00, 0x00, 0x00, 0x00, 0x00,
    0x80, 0x80, 0xC0, 0xC0, 0xC0, 0xC0, 0xC0, 0xC0, 0x80, 0x00, 0x00, 0x00, 0x00, 0x00, 0x80, 0x80,
    0xC0, 0xC0, 0xC0, 0xC0, 0xC0, 0xC0, 0x80, 0x00, 0x00, 0x00, 0xFF, 0xFF, 0xFF, 0xFF, 0xFF, 0x00,
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    0x07, 0x07, 0x07, 0x03, 0x00, 0x00, 0x07, 0x07, 0x07, 0x07, 0x07, 0x00, 0x00, 0x00, 0x00, 0x00,
};

PROGMEM static const uint8_t imgMan[] = { // 40x40
    0x00, 0x00, 0x00, 0x00, 0x00, 0x00, 0x00, 0x80, 0xC0, 0xE0, 0xF0, 0x70, 0x78, 0x78, 0x00, 0xF8,
    0xFC, 0x06, 0xF3, 0xF9, 0xFD, 0xFD, 0xFD, 0xF9, 0xF2, 0x04, 0xF8, 0x00, 0x60, 0x40, 0x80, 0x00,
    0x00, 0x00, 0x00, 0x00, 0x00, 0x00, 0x00, 0x00, 0x00, 0x00, 0x00, 0xE0, 0xD8, 0xD6, 0xCB, 0xD4,
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    0x3F, 0x00, 0x00, 0x01, 0x01, 0x01, 0x01, 0x00,
};

PROGMEM static const uint8_t imgEyes[] = { // 10x8x3
    0xFD, 0x81, 0x81, 0xFD, 0xFD, 0xFD, 0xFE, 0xC0, 0xC0, 0xFE, 0xFD, 0x8D, 0x8D, 0xFD, 0xFD, 0xFD,
    0xFE, 0xC6, 0xC6, 0xFE, 0xDD, 0xDD, 0xDD, 0xDD, 0xFD, 0xFD, 0xEE, 0xEE, 0xEE, 0xEE,
};

PROGMEM static const uint8_t imgHeadLight[] = { // 7x8
    0x3C, 0x7E, 0xFF, 0xFF, 0xFF, 0x7E, 0x3C,
};

PROGMEM static const uint8_t imgHeadLightOff[7] = {};

PROGMEM static const PoomNote sound1[] = {
    {440, 10}, {0, 0}
};

PROGMEM static const PoomNote sound2[] = {
    {587, 20}, {0, 0}
};

PROGMEM static const char menuGame[] = "START GAME";
PROGMEM static const char menuSound[] = "SOUND ";
PROGMEM static const char menuRecord[] = "RECORD";
PROGMEM static const char menuCredit[] = "CREDIT";

PROGMEM static const char * const menusTable[] = {
    menuGame, menuSound, menuRecord, menuCredit
};

PROGMEM static const char credit0[] = "- " APP_TITLE " -";
PROGMEM static const char credit1[] = APP_RELEASED;
PROGMEM static const char credit2[] = "PROGRAMMED BY OBONO";
PROGMEM static const char credit3[] = "THIS PROGRAM IS";
PROGMEM static const char credit4[] = "RELEASED UNDER";
PROGMEM static const char credit5[] = "THE MIT LICENSE.";

PROGMEM static const char * const creditsTable[] = {
    credit0, NULL, credit1, credit2, NULL, credit3, credit4, credit5
};

static uint8_t  state;
static bool     toDraw;
static bool     sound;
static int8_t   menuPos;
static uint16_t lastScore = 0;
static uint8_t  recordState = RECORD_NOT_READ;
static uint16_t hiScore[10];
static uint16_t playCount;
static uint32_t playFrames;
static uint8_t  eyesWait;
static int8_t   lightColor;
static bool     lightBlink;
static uint8_t  lightWait;

void initTitle(void)
{
    state = STATE_MENU;
    toDraw = true;
    setSound(Poom.audio().enabled());
    menuPos = 0;

    if (recordState == RECORD_NOT_READ) {
        readRecord();
    }

    eyesWait = rnd(100) + 150;
    lightColor = 1;
    lightBlink = false;
    lightWait = rnd(180) + 60;
}

bool updateTitle(void)
{
    bool ret = false;
    if (state == STATE_MENU) {
        /*  Animation  */
        if (eyesWait-- == 0) eyesWait = rnd(100) + 150;
        if (lightBlink && (lightWait & 1)) lightColor = 1 - lightColor;
        if (lightWait-- == 0) {
            lightBlink = !lightBlink;
            lightWait = rnd(180) + 60;
        }
        /*  Button handling  */
        if (Poom.justPressed(PoomButtonUp)) {
            if (menuPos-- == 0) menuPos = 3;
            playSound1();
            toDraw = true;
        }
        if (Poom.justPressed(PoomButtonDown)) {
            if (menuPos++ == 3) menuPos = 0;
            playSound1();
            toDraw = true;
        }
        if (Poom.justPressed(PoomButtonA | PoomButtonB)) {
            switch (menuPos) {
            case 0:
                ret = true;
                Poom.audio().saveEnabled();
                break;
            case 1:
                setSound(!sound);
                playSound2();
                break;
            case 2:
                state = STATE_RECORD;
                playSound2();
                break;
            case 3:
                state = STATE_CREDIT;
                playSound2();
                break;
            }
            toDraw = true;
        }
    } else {
        if (Poom.justPressed(PoomButtonA | PoomButtonB)) {
            state = STATE_MENU;
            playSound2();
            toDraw = true;
        }
    }

    randomSeed(rand() ^ micros()); // Shuffle random
    return ret;
}

void drawTitle(void)
{
    if (toDraw) {
        char buf[22];
        const char *p;
        Poom.fill(false);
        switch (state) {
        case STATE_MENU:
            Poom.drawPageBitmap(3, 0, imgTitle1, 84, 20);
            Poom.drawPageBitmap(45, 19, imgTitle2, 80, 20);
            Poom.drawPageBitmap(4, 24, imgMan, 40, 40);
            if (lastScore > 0) {
                HollowPoom::printAt(98, 0, F("LAST"));
                HollowPoom::printAt(98, 6, F("SCORE"));
                sprintf(buf, "%5d", lastScore);
                HollowPoom::printAt(98, 14, buf);
            }
            for (int i = 0; i < 4; i++) {
                p = static_cast<const char *>(pgm_read_ptr(menusTable + i));
                strcpy_P(buf, p);
                HollowPoom::printAt(64 - (i == menuPos) * 4, i * 6 + 40, buf);
                if (p == menuSound) {
                    HollowPoom::print((sound) ? F("ON") : F("OFF"));
                }
            }
            Poom.fillRect(52, menuPos * 6 + 40, 5, 5);
            break;
        case STATE_RECORD:
            HollowPoom::printAt(22, 4, F("BEST 10 SCORES"));
            Poom.drawHorizontalLine(0, 12, 127);
            for (int i = 0; i < 2; i++) {
                for (int j = 0; j < 5; j++) {
                    int r = i * 5 + j;
                    HollowPoom::printAt(i * 60 + 4 - (r == 9) * 6, j * 6 + 14, F("["));
                    HollowPoom::print(r + 1);
                    HollowPoom::print(F("] "));
                    HollowPoom::print(hiScore[r]);
                }
            }
            Poom.drawHorizontalLine(0, 44, 127);
            HollowPoom::printAt(16, 48, F("PLAY COUNT "));
            HollowPoom::print(playCount);
            HollowPoom::printAt(16, 54, F("PLAY TIME  "));
            HollowPoom::print(playFrames / 3600); // minutes
            sprintf(buf, "'%02lu\"", playFrames / 60 % 60); // seconds
            HollowPoom::print(buf);
            break;
        case STATE_CREDIT:
            for (int i = 0; i < 8; i++) {
                p = static_cast<const char *>(pgm_read_ptr(creditsTable + i));
                if (p != NULL) {
                    strcpy_P(buf, p);
                    uint8_t len = strnlen(buf, sizeof(buf));
                    HollowPoom::printAt(64 - len * 3, i * 6 + 8, buf);
                }
            }
            break;
        }
        toDraw = false;
    }

    /*  Animation  */
    if (state == STATE_MENU) {
        uint8_t ani = max(3 - eyesWait / 4, 0);
        if (ani == 3) ani = 1;
        memcpy_P(Poom.buffer() + 660, imgEyes + ani * 10, 10);
        //Poom.fillRect(20, 40, 10, 8, false);
        //Poom.drawPageBitmap(20, 40, imgEyes + ani * 10, 10, 8);
        if (lightColor) {
            Poom.drawPageBitmap(22, 26, imgHeadLight, 7, 8);
        } else {
            Poom.drawPageBitmapMasked(22, 26, imgHeadLightOff, imgHeadLight, 7, 8);
        }
    }
}

uint8_t setLastScore(int score, uint32_t frames)
{
    lastScore = score;

    /*  Updarte best 10  */
    int r = 10;
    uint16_t h;
    while (r > 0 && (h = hiScore[r - 1]) < score) {
        if (--r < 9) hiScore[r + 1] = h;
    }
    if (r < 10) hiScore[r] = score;
    playCount++;
    playFrames += frames;

    HollowRecord record = {};
    record.signature = RecordSignature;
    for (int i = 0; i < 10; i++) {
        record.highScores[i] = hiScore[i];
    }
    record.playCount = playCount;
    record.playFrames = playFrames;

    if (Poom.storage().writeBytes(RecordKey, &record, sizeof(record))) {
        recordState = RECORD_STORED;
    }
    return r;
}

static void readRecord(void)
{
    HollowRecord record = {};
    const bool isRegular =
        Poom.storage().readBytes(RecordKey, &record, sizeof(record)) == sizeof(record) &&
        record.signature == RecordSignature;

    if (isRegular) {
        for (int i = 0; i < 10; i++) {
            hiScore[i] = record.highScores[i];
        }
        playCount = record.playCount;
        playFrames = record.playFrames;
        recordState = RECORD_STORED;
    } else {
        /*  Initialize record  */
        for (int i = 0; i < 10; i++) {
            hiScore[i] = 0;
        }
        playCount = 0;
        playFrames = 0;
        recordState = RECORD_INITIAL;
    }
}

static void setSound(bool enabled)
{
    Poom.audio().setEnabled(enabled);
    Poom.audio().saveEnabled();
    sound = enabled;
}

static void playSound1(void)
{
    HollowPoom::playScore(sound1, 255);
}

static void playSound2(void)
{
    HollowPoom::playScore(sound2, 255);
}
